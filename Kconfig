## Kconfig
```kconfig
# Project-level Kconfig
menu "WiFi Manager"

    config WIFI_MGR_DEV_MODE
        bool "Development mode: clear WiFi config on every flash"
        default y
        help
            When enabled (development), WiFi SSID/password saved in NVS
            will be erased on every startup, forcing the device into
            configuration portal mode after each firmware flash.

            When disabled (production), existing WiFi credentials are
            preserved across firmware updates; the device connects
            automatically to the previously configured AP.

endmenu
```
